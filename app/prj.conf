## CMakeLists.txt
```
# SPDX-License-Identifier: Apache-2.0

cmake_minimum_required(VERSION 3.20.0)

set(BOARD rtl8305_stm32g030)

find_package(Zephyr)
project(my_zephyr_app)

target_sources(app PRIVATE src/main.c src/rtl8305.c src/shell_cmds.c)
```

## prj.conf
```kconfig
CONFIG_GPIO=y
CONFIG_MDIO=y
CONFIG_MDIO_GPIO=y

CONFIG_SHELL=y
CONFIG_SHELL_MINIMAL=y
CONFIG_SHELL_TAB=y
CONFIG_SHELL_VT100_COLORS=y
CONFIG_SHELL_TAB_AUTOCOMPLETION=y
CONFIG_SHELL_HISTORY=y
# 20260823 CONFIG_GPIO_SHELL is too big for latest Zephyr
#CONFIG_GPIO_SHELL=y
#CONFIG_MDIO_SHELL=y
CONFIG_SHELL_PROMPT_UART="rtl8305-switch:~$ "
```

## src/main.c
```c
/*
 * Copyright (c) 2012-2014 Wind River Systems, Inc.
 *
 * SPDX-License-Identifier: Apache-2.0
 */

#include <stdio.h>
#include <zephyr/kernel.h>
#include <zephyr/drivers/mdio.h>
#include <zephyr/drivers/gpio.h>

#define MDIO_NODE DT_NODELABEL(mdio0)
#define DIP_SW_0_NODE DT_ALIAS(dip0)
#define DIP_SW_1_NODE DT_ALIAS(dip1)
#define DIP_SW_2_NODE DT_ALIAS(dip2)
#define DIP_SW_3_NODE DT_ALIAS(dip3)

#define NUM_DIP_SWITCHES 4
static const struct gpio_dt_spec dip_switches[NUM_DIP_SWITCHES] = {
	GPIO_DT_SPEC_GET(DIP_SW_0_NODE, gpios),
	GPIO_DT_SPEC_GET(DIP_SW_1_NODE, gpios),
	GPIO_DT_SPEC_GET(DIP_SW_2_NODE, gpios),
	GPIO_DT_SPEC_GET(DIP_SW_3_NODE, gpios),
};

void poll_thread(void);
#define STACKSIZE 512
#define PRIORITY 7
K_THREAD_DEFINE(poll_thread_id, STACKSIZE, poll_thread, NULL, NULL, NULL,
		PRIORITY, 0, 0);

void poll_thread(void)
{
	uint16_t data = 0;
	uint8_t reg_addr = 0;
	uint8_t phy = 0;
	uint8_t phy_num = 8;
	uint8_t link_state[phy_num];
	uint8_t link_state_new = 0;
	bool dip_sw_state[NUM_DIP_SWITCHES] = {0};

	const struct device *mdio_dev = DEVICE_DT_GET(MDIO_NODE);

	memset(link_state, 0, sizeof link_state);

	if (!device_is_ready(mdio_dev)) {
		printf("MDIO-device is not ready\n");
		return;
	}

	for (int i = 0; i < NUM_DIP_SWITCHES; i++) {
		if (!gpio_is_ready_dt(&dip_switches[i])) {
			printf("GPIO-device %d is not ready\n", i);
			return;
		}
		gpio_pin_configure_dt(&dip_switches[i], GPIO_INPUT);
	}

	printf("Polling thread running ...\n");

	for(;;) {
		// Poll PHYs for link state changes
		for(int i=0; i<phy_num; i++) {
			phy = i;
			reg_addr = 1;
			if (mdio_read(mdio_dev, phy, reg_addr, &data) >= 0 && data != UINT16_MAX) {
				link_state_new = (data >> 2) & 0x1;
				if(link_state_new != link_state[i]) {
					if(link_state_new)
						printf("PHY %i link is up\n", phy);
					else
						printf("PHY %i link is down\n", phy);

					link_state[i] = link_state_new;
					//printf("PHY %i, reg %i is 0x%x Link: %i\n", phy, reg_addr, data, link_state[i]);
				}
			}
		}

		// Poll DIP switches
		for (int i = 0; i < NUM_DIP_SWITCHES; i++) {
			bool current_state = gpio_pin_get_dt(&dip_switches[i]);
			if (current_state != dip_sw_state[i]) {
				dip_sw_state[i] = current_state;
				if (dip_sw_state[i] == 0)
					printf("DIP switch %d is ON\n", i);
				else
					printf("DIP switch %d is OFF\n", i);
			}
		}

		k_msleep(0.5e3);
	}
}

int main(void)
{
	printf("Hello %s\n", CONFIG_BOARD_TARGET);
	printf("Build date and time: %s %s\n", __DATE__, __TIME__);

	return 0;
}
```

## src/rtl8305.c
```c
/*
 * SPDX-License-Identifier: Apache-2.0
 *
 * RTL8305 switch register access layer.
 */

#include <zephyr/kernel.h>
#include <zephyr/drivers/mdio.h>
#include <zephyr/sys/printk.h>

#include "rtl8305.h"

int rtl8305_read(const struct device *dev, uint8_t phy, uint8_t reg,
		 uint16_t *val)
{
	int ret;

	if (dev == NULL || val == NULL) {
		return -EINVAL;
	}

	ret = mdio_read(dev, phy, reg, val);
	if (ret < 0) {
		return ret;
	}

	/* 0xFFFF indicates no device present on the bus. */
	if (*val == UINT16_MAX) {
		return -ENODEV;
	}

	return 0;
}

int rtl8305_write(const struct device *dev, uint8_t phy, uint8_t reg,
		  uint16_t val)
{
	if (dev == NULL) {
		return -EINVAL;
	}

	return mdio_write(dev, phy, reg, val);
}

int rtl8305_get_chip_id(const struct device *dev, uint16_t *id)
{
	return rtl8305_read(dev, 0, RTL8305_CHIP_ID_REG, id);
}

int rtl8305_get_link_state(const struct device *dev, uint8_t phy, bool *link)
{
	uint16_t val;
	int ret;

	if (link == NULL) {
		return -EINVAL;
	}

	ret = rtl8305_read(dev, phy, RTL8305_MII_STATUS_REG, &val);
	if (ret < 0) {
		return ret;
	}

	*link = (val & RTL8305_MII_LINK_BIT) != 0;

	return 0;
}

int rtl8305_dump(const struct device *dev, uint8_t phy, uint8_t start,
		 uint8_t count)
{
	uint16_t val;
	int ret;

	if (dev == NULL) {
		return -EINVAL;
	}

	for (uint8_t i = 0; i < count; i++) {
		ret = rtl8305_read(dev, phy, start + i, &val);
		if (ret < 0) {
			printk("reg 0x%02x: read failed (%d)\n", start + i, ret);
			return ret;
		}
		printk("reg 0x%02x: 0x%04x\n", start + i, val);
	}

	return 0;
}

/* ------------------------------------------------------------------ */
/* VLAN helpers                                                       */
/* ------------------------------------------------------------------ */

static int vlan_port_index_reg(uint8_t port, uint8_t *reg, uint8_t *shift)
{
	switch (port) {
	case 0:
		*reg = RTL8305_REG_PORT_INDEX_0_3;
		*shift = RTL8305_P0VLANINDEX_SHIFT;
		break;
	case 1:
		*reg = RTL8305_REG_PORT_INDEX_0_3;
		*shift = RTL8305_P1VLANINDEX_SHIFT;
		break;
	case 2:
		*reg = RTL8305_REG_PORT_INDEX_0_3;
		*shift = RTL8305_P2VLANINDEX_SHIFT;
		break;
	case 3:
		*reg = RTL8305_REG_PORT_INDEX_0_3;
		*shift = RTL8305_P3VLANINDEX_SHIFT;
		break;
	case 4:
		*reg = RTL8305_REG_PORT_INDEX_4;
		*shift = RTL8305_P4VLANINDEX_SHIFT;
		break;
	default:
		return -EINVAL;
	}

	return 0;
}

int rtl8305_vlan_get_port_index(const struct device *dev, uint8_t port,
				uint8_t *index)
{
	uint8_t reg, shift;
	uint16_t val;
	int ret;

	if (dev == NULL || index == NULL) {
		return -EINVAL;
	}

	ret = vlan_port_index_reg(port, &reg, &shift);
	if (ret < 0) {
		return ret;
	}

	ret = rtl8305_read(dev, RTL8305_PHY_PORT_INDEX, reg, &val);
	if (ret < 0) {
		return ret;
	}

	*index = (val >> shift) & RTL8305_VLANINDEX_MASK;

	return 0;
}

int rtl8305_vlan_set_port_index(const struct device *dev, uint8_t port,
				uint8_t index)
{
	uint8_t reg, shift;
	uint16_t val;
	int ret;

	if (dev == NULL || index > RTL8305_VLANINDEX_MASK) {
		return -EINVAL;
	}

	ret = vlan_port_index_reg(port, &reg, &shift);
	if (ret < 0) {
		return ret;
	}

	ret = rtl8305_read(dev, RTL8305_PHY_PORT_INDEX, reg, &val);
	if (ret < 0) {
		return ret;
	}

	val &= ~(RTL8305_VLANINDEX_MASK << shift);
	val |= (uint16_t)(index & RTL8305_VLANINDEX_MASK) << shift;

	return rtl8305_write(dev, RTL8305_PHY_PORT_INDEX, reg, val);
}

int rtl8305_vlan_get_vid(const struct device *dev, uint8_t group,
			 uint16_t *vid)
{
	uint16_t hi, lo;
	int ret;

	if (dev == NULL || vid == NULL || group >= RTL8305_NUM_VLAN_GROUPS) {
		return -EINVAL;
	}

	switch (group) {
	case RTL8305_VLAN_A:
		return rtl8305_read(dev, RTL8305_PHY_VLAN, RTL8305_REG_VIDA, vid);
	case RTL8305_VLAN_B:
		ret = rtl8305_read(dev, RTL8305_PHY_VLAN, RTL8305_REG_VIDB_HI, &hi);
		if (ret < 0) {
			return ret;
		}
		ret = rtl8305_read(dev, RTL8305_PHY_VLAN, RTL8305_REG_VIDB_LO, &lo);
		if (ret < 0) {
			return ret;
		}
		*vid = ((hi >> 8) << 4) | (lo & 0x0f);
		return 0;
	case RTL8305_VLAN_C:
		return rtl8305_read(dev, RTL8305_PHY_VLAN, RTL8305_REG_VIDC, vid);
	case RTL8305_VLAN_D:
		ret = rtl8305_read(dev, RTL8305_PHY_VLAN, RTL8305_REG_VIDD_HI, &hi);
		if (ret < 0) {
			return ret;
		}
		ret = rtl8305_read(dev, RTL8305_PHY_VLAN, RTL8305_REG_VIDD_LO, &lo);
		if (ret < 0) {
			return ret;
		}
		*vid = ((hi >> 8) << 4) | (lo & 0x0f);
		return 0;
	case RTL8305_VLAN_E:
		return rtl8305_read(dev, RTL8305_PHY_VLAN, RTL8305_REG_VIDE, vid);
	default:
		return -EINVAL;
	}
}

int rtl8305_vlan_set_vid(const struct device *dev, uint8_t group,
			 uint16_t vid)
{
	uint16_t hi, lo;
	int ret;

	if (dev == NULL || group >= RTL8305_NUM_VLAN_GROUPS || vid > 0xfff) {
		return -EINVAL;
	}

	switch (group) {
	case RTL8305_VLAN_A:
		return rtl8305_write(dev, RTL8305_PHY_VLAN, RTL8305_REG_VIDA, vid);
	case RTL8305_VLAN_B:
		ret = rtl8305_read(dev, RTL8305_PHY_VLAN, RTL8305_REG_VIDB_HI, &hi);
		if (ret < 0) {
			return ret;
		}
		ret = rtl8305_read(dev, RTL8305_PHY_VLAN, RTL8305_REG_VIDB_LO, &lo);
		if (ret < 0) {
			return ret;
		}
		hi = (hi & 0x00ff) | ((uint16_t)(vid >> 4) << 8);
		lo = (lo & 0xfff0) | (vid & 0x0f);
		ret = rtl8305_write(dev, RTL8305_PHY_VLAN, RTL8305_REG_VIDB_HI, hi);
		if (ret < 0) {
			return ret;
		}
		return rtl8305_write(dev, RTL8305_PHY_VLAN, RTL8305_REG_VIDB_LO, lo);
	case RTL8305_VLAN_C:
		return rtl8305_write(dev, RTL8305_PHY_VLAN, RTL8305_REG_VIDC, vid);
	case RTL8305_VLAN_D:
		ret = rtl8305_read(dev, RTL8305_PHY_VLAN, RTL8305_REG_VIDD_HI, &hi);
		if (ret < 0) {
			return ret;
		}
		ret = rtl8305_read(dev, RTL8305_PHY_VLAN, RTL8305_REG_VIDD_LO, &lo);
		if (ret < 0) {
			return ret;
		}
		hi = (hi & 0x00ff) | ((uint16_t)(vid >> 4) << 8);
		lo = (lo & 0xfff0) | (vid & 0x0f);
		ret = rtl8305_write(dev, RTL8305_PHY_VLAN, RTL8305_REG_VIDD_HI, hi);
		if (ret < 0) {
			return ret;
		}
		return rtl8305_write(dev, RTL8305_PHY_VLAN, RTL8305_REG_VIDD_LO, lo);
	case RTL8305_VLAN_E:
		return rtl8305_write(dev, RTL8305_PHY_VLAN, RTL8305_REG_VIDE, vid);
	default:
		return -EINVAL;
	}
}

int rtl8305_vlan_get_member(const struct device *dev, uint8_t group,
			    uint8_t *member)
{
	uint8_t reg;
	uint16_t val;
	int ret;

	if (dev == NULL || member == NULL || group >= RTL8305_NUM_VLAN_GROUPS) {
		return -EINVAL;
	}

	switch (group) {
	case RTL8305_VLAN_A:
		reg = RTL8305_REG_MEMBERA;
		break;
	case RTL8305_VLAN_B:
		reg = RTL8305_REG_MEMBERB;
		break;
	case RTL8305_VLAN_C:
		reg = RTL8305_REG_MEMBERC;
		break;
	case RTL8305_VLAN_D:
		reg = RTL8305_REG_MEMBERD;
		break;
	case RTL8305_VLAN_E:
		reg = RTL8305_REG_MEMBERE;
		break;
	default:
		return -EINVAL;
	}

	ret = rtl8305_read(dev, RTL8305_PHY_VLAN, reg, &val);
	if (ret < 0) {
		return ret;
	}

	*member = (val >> RTL8305_MEMBER_SHIFT) & RTL8305_MEMBER_MASK;

	return 0;
}

int rtl8305_vlan_set_member(const struct device *dev, uint8_t group,
			    uint8_t member)
{
	uint8_t reg;
	uint16_t val;
	int ret;

	if (dev == NULL || group >= RTL8305_NUM_VLAN_GROUPS ||
	    member > RTL8305_MEMBER_MASK) {
		return -EINVAL;
	}

	switch (group) {
	case RTL8305_VLAN_A:
		reg = RTL8305_REG_MEMBERA;
		break;
	case RTL8305_VLAN_B:
		reg = RTL8305_REG_MEMBERB;
		break;
	case RTL8305_VLAN_C:
		reg = RTL8305_REG_MEMBERC;
		break;
	case RTL8305_VLAN_D:
		reg = RTL8305_REG_MEMBERD;
		break;
	case RTL8305_VLAN_E:
		reg = RTL8305_REG_MEMBERE;
		break;
	default:
		return -EINVAL;
	}

	ret = rtl8305_read(dev, RTL8305_PHY_VLAN, reg, &val);
	if (ret < 0) {
		return ret;
	}

	val &= ~(RTL8305_MEMBER_MASK << RTL8305_MEMBER_SHIFT);
	val |= (uint16_t)(member & RTL8305_MEMBER_MASK) << RTL8305_MEMBER_SHIFT;

	return rtl8305_write(dev, RTL8305_PHY_VLAN, reg, val);
}

int rtl8305_vlan_get_ctrl(const struct device *dev, uint16_t *ctrl)
{
	if (dev == NULL || ctrl == NULL) {
		return -EINVAL;
	}

	return rtl8305_read(dev, RTL8305_PHY_VLAN_CTRL, RTL8305_REG_VLAN_CTRL,
			    ctrl);
}

int rtl8305_vlan_set_ctrl(const struct device *dev, uint16_t ctrl)
{
	if (dev == NULL) {
		return -EINVAL;
	}

	return rtl8305_write(dev, RTL8305_PHY_VLAN_CTRL, RTL8305_REG_VLAN_CTRL,
			     ctrl);
}

int rtl8305_soft_reset(const struct device *dev)
{
	if (dev == NULL) {
		return -EINVAL;
	}

	return rtl8305_write(dev, RTL8305_PHY_PORT_CTRL, RTL8305_REG_PORT_CTRL,
			     RTL8305_PORT_CTRL_SOFTRESET);
}

int rtl8305_vlan_lan(const struct device *dev, uint8_t port, uint16_t vid)
{
	uint8_t group;
	uint8_t member[RTL8305_NUM_VLAN_GROUPS];
	uint16_t group_vid;
	int ret;

	if (dev == NULL || port >= RTL8305_NUM_PORTS || vid > 0xfff) {
		return -EINVAL;
	}

	/* Port N maps to group N. */
	group = port;

	/* Set the group VID and assign the port to that group. */
	ret = rtl8305_vlan_set_vid(dev, group, vid);
	if (ret < 0) {
		return ret;
	}

	ret = rtl8305_vlan_set_port_index(dev, port, group);
	if (ret < 0) {
		return ret;
	}

	/*
	 * Recompute every group's member set so that ports sharing the
	 * same VID can communicate. A group's member set is the union of
	 * all ports whose group currently has that group's VID.
	 */
	for (uint8_t g = 0; g < RTL8305_NUM_VLAN_GROUPS; g++) {
		member[g] = 0;
	}

	for (uint8_t p = 0; p < RTL8305_NUM_PORTS; p++) {
		uint8_t p_index;

		ret = rtl8305_vlan_get_port_index(dev, p, &p_index);
		if (ret < 0) {
			return ret;
		}

		ret = rtl8305_vlan_get_vid(dev, p_index, &group_vid);
		if (ret < 0) {
			return ret;
		}

		/* Port p joins every group whose VID matches its own. */
		for (uint8_t g = 0; g < RTL8305_NUM_VLAN_GROUPS; g++) {
			uint16_t g_vid;

			ret = rtl8305_vlan_get_vid(dev, g, &g_vid);
			if (ret < 0) {
				return ret;
			}

			if (g_vid == group_vid) {
				member[g] |= BIT(p);
			}
		}
	}

	for (uint8_t g = 0; g < RTL8305_NUM_VLAN_GROUPS; g++) {
		ret = rtl8305_vlan_set_member(dev, g, member[g]);
		if (ret < 0) {
			return ret;
		}
	}

	return rtl8305_soft_reset(dev);
}
```

## src/rtl8305.h
```c
/*
 * SPDX-License-Identifier: Apache-2.0
 *
 * RTL8305 switch register access layer.
 *
 * The RTL8305 exposes its internal register space through pseudo-PHY
 * addresses on the MDIO bus (Clause 22, 16-bit registers). This module
 * wraps the Zephyr MDIO API and provides helpers used by the shell
 * commands.
 */

#ifndef RTL8305_H
#define RTL8305_H

#include <stdint.h>
#include <zephyr/device.h>

/* Placeholder register addresses - fill in from the RTL8305 datasheet. */
#define RTL8305_CHIP_ID_REG 0x00 /* Chip ID / version register */

/* MII status register (reg 1) link status bit. */
#define RTL8305_MII_STATUS_REG 0x01
#define RTL8305_MII_LINK_BIT   BIT(2)

/*
 * VLAN configuration registers.
 *
 * The RTL8305 supports 5 VLAN groups (A-E). Each port is mapped to a
 * group via its Port VLAN Index. Each group has a 12-bit VID and a
 * 5-bit member set (bit N = port N). All of these are EEPROM/Pin
 * registers: after writing them via SMI a soft reset (PHY3 Reg16.15)
 * is required for the changes to take effect.
 */

/* Pseudo-PHY addresses used for the VLAN registers. */
#define RTL8305_PHY_PORT_INDEX 0x0 /* PHY0: port VLAN index regs 21/22 */
#define RTL8305_PHY_VLAN       0x1 /* PHY1: group VID + member regs 24-31 */
#define RTL8305_PHY_VLAN_CTRL  0x2 /* PHY2: VLAN control reg 17 */
#define RTL8305_PHY_PORT_CTRL  0x3 /* PHY3: port control reg 16 (soft reset) */

/* PHY0 Reg21: Port 0-3 VLAN index. */
#define RTL8305_REG_PORT_INDEX_0_3 0x15
#define RTL8305_P0VLANINDEX_SHIFT  0
#define RTL8305_P1VLANINDEX_SHIFT  4
#define RTL8305_P2VLANINDEX_SHIFT  8
#define RTL8305_P3VLANINDEX_SHIFT  12
#define RTL8305_VLANINDEX_MASK     0x7

/* PHY0 Reg22: Port 4 VLAN index. */
#define RTL8305_REG_PORT_INDEX_4 0x16
#define RTL8305_P4VLANINDEX_SHIFT 0

/* PHY1 Reg24-31: group VID and member set. */
#define RTL8305_REG_VIDA 0x18 /* Reg24: VIDA[11:0] */
#define RTL8305_REG_VIDB_HI 0x19 /* Reg25: VIDB[11:8] in [15:8] */
#define RTL8305_REG_VIDB_LO 0x1a /* Reg26: VIDB[7:0] in [3:0] */
#define RTL8305_REG_VIDC 0x1b /* Reg27: VIDC[11:0] */
#define RTL8305_REG_VIDD_HI 0x1c /* Reg28: VIDD[11:8] in [15:8] */
#define RTL8305_REG_VIDD_LO 0x1d /* Reg29: VIDD[7:0] in [3:0] */
#define RTL8305_REG_VIDE 0x1e /* Reg30: VIDE[11:0] */

#define RTL8305_REG_MEMBERA 0x19 /* Reg25: MemberA[4:0] */
#define RTL8305_REG_MEMBERB 0x1a /* Reg26: MemberB[4:0] in [12:8] */
#define RTL8305_REG_MEMBERC 0x1c /* Reg28: MemberC[4:0] */
#define RTL8305_REG_MEMBERD 0x1d /* Reg29: MemberD[4:0] in [12:8] */
#define RTL8305_REG_MEMBERE 0x1f /* Reg31: MemberE[4:0] */

#define RTL8305_MEMBER_SHIFT 8
#define RTL8305_MEMBER_MASK  0x1f

/* PHY2 Reg17: VLAN control. */
#define RTL8305_REG_VLAN_CTRL 0x11
#define RTL8305_VLAN_CTRL_DISVLAN        BIT(5)
#define RTL8305_VLAN_CTRL_DISTAGAWARE    BIT(4)
#define RTL8305_VLAN_CTRL_DISMEMFILTER   BIT(3)
#define RTL8305_VLAN_CTRL_DISTAGADMIT    BIT(2)
#define RTL8305_VLAN_CTRL_DISLEAKY       BIT(1)
#define RTL8305_VLAN_CTRL_DISARP         BIT(0)

/* PHY3 Reg16: port control / soft reset. */
#define RTL8305_REG_PORT_CTRL 0x10
#define RTL8305_PORT_CTRL_SOFTRESET BIT(15)

/* Number of VLAN groups and ports. */
#define RTL8305_NUM_VLAN_GROUPS 5
#define RTL8305_NUM_PORTS       5

/* VLAN group identifiers (0=A, 1=B, 2=C, 3=D, 4=E). */
enum rtl8305_vlan_group {
	RTL8305_VLAN_A = 0,
	RTL8305_VLAN_B,
	RTL8305_VLAN_C,
	RTL8305_VLAN_D,
	RTL8305_VLAN_E,
};

/**
 * @brief Read a 16-bit RTL8305 register via MDIO.
 *
 * @param dev   MDIO device
 * @param phy   Pseudo-PHY address (0x0 - 0x8)
 * @param reg   Register address
 * @param val   Pointer to store the read value
 *
 * @return 0 on success, negative errno otherwise.
 */
int rtl8305_read(const struct device *dev, uint8_t phy, uint8_t reg,
		 uint16_t *val);

/**
 * @brief Write a 16-bit RTL8305 register via MDIO.
 *
 * @param dev   MDIO device
 * @param phy   Pseudo-PHY address (0x0 - 0x8)
 * @param reg   Register address
 * @param val   Value to write
 *
 * @return 0 on success, negative errno otherwise.
 */
int rtl8305_write(const struct device *dev, uint8_t phy, uint8_t reg,
		  uint16_t val);

/**
 * @brief Read the RTL8305 chip ID / version.
 *
 * @param dev   MDIO device
 * @param id    Pointer to store the chip ID
 *
 * @return 0 on success, negative errno otherwise.
 */
int rtl8305_get_chip_id(const struct device *dev, uint16_t *id);

/**
 * @brief Read the link state of a port.
 *
 * @param dev   MDIO device
 * @param phy   Pseudo-PHY address (0x0 - 0x8)
 * @param link  Pointer to store the link state (true = up)
 *
 * @return 0 on success, negative errno otherwise.
 */
int rtl8305_get_link_state(const struct device *dev, uint8_t phy, bool *link);

/**
 * @brief Dump a range of RTL8305 registers.
 *
 * @param dev    MDIO device
 * @param phy    Pseudo-PHY address (0x0 - 0x8)
 * @param start  First register address
 * @param count  Number of registers to dump
 *
 * @return 0 on success, negative errno otherwise.
 */
int rtl8305_dump(const struct device *dev, uint8_t phy, uint8_t start,
		 uint8_t count);

/**
 * @brief Get the VLAN group index a port is assigned to.
 *
 * @param dev    MDIO device
 * @param port   Port number (0 - 4)
 * @param index  Pointer to store the VLAN group index (0=A .. 4=E)
 *
 * @return 0 on success, negative errno otherwise.
 */
int rtl8305_vlan_get_port_index(const struct device *dev, uint8_t port,
				uint8_t *index);

/**
 * @brief Set the VLAN group index a port is assigned to.
 *
 * @param dev    MDIO device
 * @param port   Port number (0 - 4)
 * @param index  VLAN group index (0=A .. 4=E)
 *
 * @return 0 on success, negative errno otherwise.
 */
int rtl8305_vlan_set_port_index(const struct device *dev, uint8_t port,
				uint8_t index);

/**
 * @brief Get the 12-bit VID of a VLAN group.
 *
 * @param dev    MDIO device
 * @param group  VLAN group (0=A .. 4=E)
 * @param vid    Pointer to store the VID
 *
 * @return 0 on success, negative errno otherwise.
 */
int rtl8305_vlan_get_vid(const struct device *dev, uint8_t group,
			 uint16_t *vid);

/**
 * @brief Set the 12-bit VID of a VLAN group.
 *
 * @param dev    MDIO device
 * @param group  VLAN group (0=A .. 4=E)
 * @param vid    VID value (0 - 0xFFF)
 *
 * @return 0 on success, negative errno otherwise.
 */
int rtl8305_vlan_set_vid(const struct device *dev, uint8_t group,
			 uint16_t vid);

/**
 * @brief Get the member set of a VLAN group.
 *
 * @param dev     MDIO device
 * @param group   VLAN group (0=A .. 4=E)
 * @param member  Pointer to store the member set (bit N = port N)
 *
 * @return 0 on success, negative errno otherwise.
 */
int rtl8305_vlan_get_member(const struct device *dev, uint8_t group,
			    uint8_t *member);

/**
 * @brief Set the member set of a VLAN group.
 *
 * @param dev     MDIO device
 * @param group   VLAN group (0=A .. 4=E)
 * @param member  Member set (bit N = port N)
 *
 * @return 0 on success, negative errno otherwise.
 */
int rtl8305_vlan_set_member(const struct device *dev, uint8_t group,
			    uint8_t member);

/**
 * @brief Read the VLAN control register.
 *
 * @param dev   MDIO device
 * @param ctrl  Pointer to store the control register value
 *
 * @return 0 on success, negative errno otherwise.
 */
int rtl8305_vlan_get_ctrl(const struct device *dev, uint16_t *ctrl);

/**
 * @brief Write the VLAN control register.
 *
 * @param dev   MDIO device
 * @param ctrl  Control register value
 *
 * @return 0 on success, negative errno otherwise.
 */
int rtl8305_vlan_set_ctrl(const struct device *dev, uint16_t ctrl);

/**
 * @brief Trigger a soft reset (required after VLAN register writes).
 *
 * @param dev  MDIO device
 *
 * @return 0 on success, negative errno otherwise.
 */
int rtl8305_soft_reset(const struct device *dev);

/**
 * @brief Assign a port to a LAN VLAN.
 *
 * Maps the port to its default group (port N -> group N), sets the
 * group VID, assigns the port to that group, and recomputes the member
 * set of every group so that ports sharing the same VID can
 * communicate. Ends with a soft reset.
 *
 * @param dev   MDIO device
 * @param port  Port number (0 - 4)
 * @param vid   VID value (0 - 0xFFF)
 *
 * @return 0 on success, negative errno otherwise.
 */
int rtl8305_vlan_lan(const struct device *dev, uint8_t port, uint16_t vid);

#endif /* RTL8305_H */
```

## src/shell_cmds.c
```c
/*
 * SPDX-License-Identifier: Apache-2.0
 *
 * RTL8305 switch shell commands.
 */

#include <zephyr/kernel.h>
#include <zephyr/shell/shell.h>
#include <zephyr/sys/util.h>
#include <zephyr/drivers/gpio.h>

#include "rtl8305.h"

#define MDIO_NODE DT_NODELABEL(mdio0)
#define DIP_SW_0_NODE DT_ALIAS(dip0)
#define DIP_SW_1_NODE DT_ALIAS(dip1)
#define DIP_SW_2_NODE DT_ALIAS(dip2)
#define DIP_SW_3_NODE DT_ALIAS(dip3)

#define NUM_DIP_SWITCHES 4
static const struct gpio_dt_spec dip_switches[NUM_DIP_SWITCHES] = {
	GPIO_DT_SPEC_GET(DIP_SW_0_NODE, gpios),
	GPIO_DT_SPEC_GET(DIP_SW_1_NODE, gpios),
	GPIO_DT_SPEC_GET(DIP_SW_2_NODE, gpios),
	GPIO_DT_SPEC_GET(DIP_SW_3_NODE, gpios),
};

static const struct device *rtl8305_mdio_dev(void)
{
	return DEVICE_DT_GET(MDIO_NODE);
}

/* status link - print the link state of all ports. */
static int cmd_status_link(const struct shell *sh, size_t argc, char **argv)
{
	const struct device *dev = rtl8305_mdio_dev();
	bool link;
	int ret;

	if (!device_is_ready(dev)) {
		shell_error(sh, "MDIO device not ready");
		return -ENODEV;
	}

	for (uint8_t phy = 0; phy <= 0x8; phy++) {
		ret = rtl8305_get_link_state(dev, phy, &link);
		if (ret < 0) {
			shell_print(sh, "PHY %u: read failed (%d)", phy, ret);
			continue;
		}

		shell_print(sh, "PHY %u: %s", phy, link ? "link up" : "link down");
	}

	return 0;
}

/* status dump <phy> <start> <count> - dump a raw register range. */
static int cmd_status_dump(const struct shell *sh, size_t argc, char **argv)
{
	const struct device *dev = rtl8305_mdio_dev();
	uint8_t phy, start, count;
	int ret;

	if (!device_is_ready(dev)) {
		shell_error(sh, "MDIO device not ready");
		return -ENODEV;
	}

	phy = (uint8_t)shell_strtoul(argv[1], 0, 0);
	start = (uint8_t)shell_strtoul(argv[2], 0, 0);
	count = (uint8_t)shell_strtoul(argv[3], 0, 0);

	if (phy > 0x8) {
		shell_error(sh, "Invalid PHY address %u (max 8)", phy);
		return -EINVAL;
	}

	ret = rtl8305_dump(dev, phy, start, count);
	if (ret < 0) {
		shell_error(sh, "Register dump failed (%d)", ret);
		return ret;
	}

	return 0;
}

/* dipsw - print the state of all DIP switches. */
static int cmd_dipsw(const struct shell *sh, size_t argc, char **argv)
{
	for (int i = 0; i < NUM_DIP_SWITCHES; i++) {
		if (!gpio_is_ready_dt(&dip_switches[i])) {
			shell_error(sh, "DIP switch %d GPIO not ready", i);
			return -ENODEV;
		}

		gpio_pin_configure_dt(&dip_switches[i], GPIO_INPUT);
		shell_print(sh, "DIP switch %d: %s", i,
			    gpio_pin_get_dt(&dip_switches[i]) ? "OFF" : "ON");
	}

	return 0;
}

/* vlan - VLAN configuration. */
static const char *vlan_group_name(uint8_t group)
{
	static const char *const names[RTL8305_NUM_VLAN_GROUPS] = {
		"A", "B", "C", "D", "E",
	};

	if (group >= RTL8305_NUM_VLAN_GROUPS) {
		return "?";
	}

	return names[group];
}

/* vlan show - display the current VLAN configuration. */
static int cmd_vlan_show(const struct shell *sh, size_t argc, char **argv)
{
	const struct device *dev = rtl8305_mdio_dev();
	uint16_t vid, ctrl;
	uint8_t member;
	int ret;

	if (!device_is_ready(dev)) {
		shell_error(sh, "MDIO device not ready");
		return -ENODEV;
	}

	ret = rtl8305_vlan_get_ctrl(dev, &ctrl);
	if (ret < 0) {
		shell_error(sh, "Failed to read VLAN control (%d)", ret);
		return ret;
	}

	shell_print(sh, "VLAN control: 0x%04x%s", ctrl,
		    (ctrl & RTL8305_VLAN_CTRL_DISVLAN) ? " (VLAN disabled)"
						       : " (VLAN enabled)");

	for (uint8_t g = 0; g < RTL8305_NUM_VLAN_GROUPS; g++) {
		ret = rtl8305_vlan_get_vid(dev, g, &vid);
		if (ret < 0) {
			shell_error(sh, "Failed to read VID of group %s (%d)",
				    vlan_group_name(g), ret);
			return ret;
		}

		ret = rtl8305_vlan_get_member(dev, g, &member);
		if (ret < 0) {
			shell_error(sh, "Failed to read member of group %s (%d)",
				    vlan_group_name(g), ret);
			return ret;
		}

		shell_print(sh, "VLAN %s: VID 0x%03x, member 0x%02x", 
			    vlan_group_name(g), vid, member);
	}

	for (uint8_t p = 0; p < RTL8305_NUM_PORTS; p++) {
		uint8_t index;

		ret = rtl8305_vlan_get_port_index(dev, p, &index);
		if (ret < 0) {
			shell_error(sh, "Failed to read port %u VLAN index (%d)",
				    p, ret);
			return ret;
		}

		shell_print(sh, "Port %u -> VLAN %s", p, vlan_group_name(index));
	}

	return 0;
}

/* vlan lan <port> <vid> - assign a port to a LAN VLAN. */
static int cmd_vlan_lan(const struct shell *sh, size_t argc, char **argv)
{
	const struct device *dev = rtl8305_mdio_dev();
	uint8_t port;
	uint16_t vid;
	int ret;

	if (!device_is_ready(dev)) {
		shell_error(sh, "MDIO device not ready");
		return -ENODEV;
	}

	port = (uint8_t)shell_strtoul(argv[1], 0, 0);
	vid = (uint16_t)shell_strtoul(argv[2], 0, 0);

	if (port >= RTL8305_NUM_PORTS) {
		shell_error(sh, "Invalid port %u (0-%u)", port,
			    RTL8305_NUM_PORTS - 1);
		return -EINVAL;
	}

	if (vid > 0xfff) {
		shell_error(sh, "Invalid VID 0x%03x (max 0xfff)", vid);
		return -EINVAL;
	}

	ret = rtl8305_vlan_lan(dev, port, vid);
	if (ret < 0) {
		shell_error(sh, "VLAN configuration failed (%d)", ret);
		return ret;
	}

	shell_print(sh, "Port %u assigned to VLAN %s (VID 0x%03x)", port,
		    vlan_group_name(port), vid);

	return 0;
}

/* vlan vid <group> <vid> - set the VID of a VLAN group. */
static int cmd_vlan_vid(const struct shell *sh, size_t argc, char **argv)
{
	const struct device *dev = rtl8305_mdio_dev();
	uint8_t group;
	uint16_t vid;
	int ret;

	if (!device_is_ready(dev)) {
		shell_error(sh, "MDIO device not ready");
		return -ENODEV;
	}

	group = (uint8_t)shell_strtoul(argv[1], 0, 0);
	vid = (uint16_t)shell_strtoul(argv[2], 0, 0);

	if (group >= RTL8305_NUM_VLAN_GROUPS) {
		shell_error(sh, "Invalid group %u (0-%u)", group,
			    RTL8305_NUM_VLAN_GROUPS - 1);
		return -EINVAL;
	}

	if (vid > 0xfff) {
		shell_error(sh, "Invalid VID 0x%03x (max 0xfff)", vid);
		return -EINVAL;
	}

	ret = rtl8305_vlan_set_vid(dev, group, vid);
	if (ret < 0) {
		shell_error(sh, "Failed to set VID (%d)", ret);
		return ret;
	}

	ret = rtl8305_soft_reset(dev);
	if (ret < 0) {
		shell_error(sh, "Soft reset failed (%d)", ret);
		return ret;
	}

	shell_print(sh, "VLAN %s VID set to 0x%03x", vlan_group_name(group),
		    vid);

	return 0;
}

/* vlan member <group> <member> - set the member set of a VLAN group. */
static int cmd_vlan_member(const struct shell *sh, size_t argc, char **argv)
{
	const struct device *dev = rtl8305_mdio_dev();
	uint8_t group, member;
	int ret;

	if (!device_is_ready(dev)) {
		shell_error(sh, "MDIO device not ready");
		return -ENODEV;
	}

	group = (uint8_t)shell_strtoul(argv[1], 0, 0);
	member = (uint8_t)shell_strtoul(argv[2], 0, 0);

	if (group >= RTL8305_NUM_VLAN_GROUPS) {
		shell_error(sh, "Invalid group %u (0-%u)", group,
			    RTL8305_NUM_VLAN_GROUPS - 1);
		return -EINVAL;
	}

	if (member > RTL8305_MEMBER_MASK) {
		shell_error(sh, "Invalid member 0x%02x (max 0x%02x)", member,
			    RTL8305_MEMBER_MASK);
		return -EINVAL;
	}

	ret = rtl8305_vlan_set_member(dev, group, member);
	if (ret < 0) {
		shell_error(sh, "Failed to set member (%d)", ret);
		return ret;
	}

	ret = rtl8305_soft_reset(dev);
	if (ret < 0) {
		shell_error(sh, "Soft reset failed (%d)", ret);
		return ret;
	}

	shell_print(sh, "VLAN %s member set to 0x%02x", vlan_group_name(group),
		    member);

	return 0;
}

SHELL_STATIC_SUBCMD_SET_CREATE(
	vlan_cmds,
	SHELL_CMD(show, NULL, "Show the current VLAN configuration",
		  cmd_vlan_show),
	SHELL_CMD_ARG(lan, NULL, "Assign a port to a LAN VLAN: lan <port> <vid>",
		      cmd_vlan_lan, 3, 0),
	SHELL_CMD_ARG(vid, NULL, "Set a group VID: vid <group> <vid>",
		      cmd_vlan_vid, 3, 0),
	SHELL_CMD_ARG(member, NULL,
		      "Set a group member set: member <group> <member>",
		      cmd_vlan_member, 3, 0),
	SHELL_SUBCMD_SET_END);

SHELL_STATIC_SUBCMD_SET_CREATE(
	status_cmds,
	SHELL_CMD(link, NULL, "Print link state of all ports", cmd_status_link),
	SHELL_CMD_ARG(dump, NULL, "Dump registers: dump <phy> <start> <count>",
		      cmd_status_dump, 4, 0),
	SHELL_SUBCMD_SET_END);

SHELL_STATIC_SUBCMD_SET_CREATE(
	ethsw_cmds,
	SHELL_CMD(status, &status_cmds, "RTL8305 switch status", NULL),
	SHELL_CMD(vlan, &vlan_cmds, "RTL8305 VLAN configuration", NULL),
	SHELL_SUBCMD_SET_END);

SHELL_CMD_REGISTER(ethsw, &ethsw_cmds, "RTL8305 switch commands", NULL);
SHELL_CMD_REGISTER(dipsw, NULL, "Print DIP switch state", cmd_dipsw);
```
