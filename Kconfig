## boards/arm/rtl8305_stm32g030/Kconfig.defconfig
```kconfig
# RTL8305 STM32G030 board configuration

# Copyright (c) 2026 Albrecht Lohofener
# SPDX-License-Identifier: Apache-2.0

if BOARD_RTL8305_STM32G030

config SPI_STM32_INTERRUPT
	default y
	depends on SPI

endif # BOARD_RTL8305_STM32G030
```

## boards/arm/rtl8305_stm32g030/Kconfig.rtl8305_stm32g030
```kconfig
# Copyright (c) 2026 Albrecht Lohofener
# SPDX-License-Identifier: Apache-2.0

config BOARD_RTL8305_STM32G030
	select SOC_STM32G030XX
```

## boards/arm/rtl8305_stm32g030/board.yml
```yaml
board:
  name: rtl8305_stm32g030
  full_name: Realtek RTL8305 Ethernet switch with STM32G030
  vendor: eth_switches
  socs:
    - name: stm32g030xx
```
